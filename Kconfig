## Kconfig
```kconfig
# Copyright (c) 2020 The ZMK Contributors
# SPDX-License-Identifier: MIT

rsource "src/drivers/Kconfig"

DT_COMPAT_ZMK_INPUT_LISTENER_PS2 := zmk,input-listener-ps2
config ZMK_INPUT_LISTENER_PS2
        bool
        default $(dt_compat_enabled,$(DT_COMPAT_ZMK_INPUT_LISTENER_PS2))

DT_COMPAT_ZMK_BEHAVIOR_MOUSE_SETTING := zmk,behavior-mouse-setting
config ZMK_BEHAVIOR_MOUSE_SETTING
        bool
        default ZMK_INPUT_MOUSE_PS2 && $(dt_compat_enabled,$(DT_COMPAT_ZMK_BEHAVIOR_MOUSE_SETTING))

DT_COMPAT_ZMK_BEHAVIOR_EXT_POWER_CONTROL := zmk,behavior-ext-power-control
config ZMK_BEHAVIOR_EXT_POWER_CONTROL
        bool "Auto-control TrackPoint power based on keyboard activity"
        default ZMK_INPUT_MOUSE_PS2 && $(dt_compat_enabled,$(DT_COMPAT_ZMK_BEHAVIOR_EXT_POWER_CONTROL))
        depends on EXT_POWER
        help
          Automatically enable/disable TrackPoint power based on keyboard activity state.
          When keyboard is idle or sleeping, TrackPoint power is disabled to save battery.
          When keyboard becomes active again, TrackPoint power is automatically re-enabled.
```

## dts/bindings/behaviors/zmk,behavior-ext-power-control.yaml
```yaml
description: External power control behavior for TrackPoint power management

compatible: "zmk,behavior-ext-power-control"

include: base.yaml
```

## dts/bindings/zmk,input-listener.yaml
```yaml
description: |
  Listener to subscribe to input events and send HID updates after processing

compatible: "zmk,input-listener-ps2"

properties:
  device:
    type: phandle
    required: true
  xy-swap:
    type: boolean
  x-invert:
    type: boolean
  y-invert:
    type: boolean
  scale-multiplier:
    type: int
    default: 1
  scale-divisor:
    type: int
    default: 1
  scroll-layer:
    type: int
    default: -1
    required: false
    description: The layer index that activates scroll mode when it is the highest active layer.
  scroll-speed-num:
    type: int
    default: 1
    required: false
    description: Numerator for scroll speed scaling factor (e.g., 1 for 1/10 speed, 2 for 2/10=1/5 speed)
  scroll-speed-den:
    type: int
    default: 2
    required: false
    description: Denominator for scroll speed scaling factor (e.g., 10 for 1/10 speed, 20 for 1/20 speed)
  scroll-deadzone:
    type: int
    default: 2
    required: false
    description: |
      Minimum absolute motion value (per axis) required to register as scroll input.
      Values at or below this threshold are treated as noise and discarded.
      Also resets the scroll accumulator to prevent noise from slowly building up.
  scroll-divisor-slow:
    type: int
    default: 60
    required: false
    description: |
      Divisor used for slow scroll movements. Higher = more input needed per scroll tick.
      The effective divisor interpolates between slow and fast based on input magnitude.
  scroll-divisor-fast:
    type: int
    default: 20
    required: false
    description: |
      Divisor used for fast scroll movements. Lower = less input needed per scroll tick.
      The effective divisor interpolates between slow and fast based on input magnitude.
  scroll-input-max:
    type: int
    default: 128
    required: false
    description: |
      The input magnitude at which the divisor reaches its minimum (scroll-divisor-fast).
      Values above this are clamped.
  scroll-dominant-axis:
    type: boolean
    required: false
    description: |
      When enabled, scroll mode locks to the dominant axis (the axis with larger movement).
      This prevents diagonal scrolling and makes vertical/horizontal scrolling more precise.
      If neither axis dominates (within a 3:2 ratio), both axes are zeroed (diagonal deadzone).
  snipe-layer:
    type: int
    default: -1
    required: false
    description: |
      Layer index that activates sniper (slow) mode. When this layer is the highest active
      layer, cursor movement is divided by snipe-divisor for precise pixel-level targeting.
      Set to -1 (default) to disable. Should not be the same value as scroll-layer.
  snipe-divisor:
    type: int
    default: 2
    required: false
    description: |
      Divisor applied to cursor movement in snipe mode. Default 2 = half speed.
      Range 2-8. Higher values = slower / more precise.
  scroll-mode-key-position:
    type: int
    default: -1
    required: false
    description: |
      ⭐ RECOMMENDED MODE: Key position that activates scroll mode when pressed (zero-latency).
      When set (>= 0), this takes priority over scroll-layer.
      
      Example: scroll-mode-key-position = <61>;  // Space key
      
      Advantages over scroll-layer:
      - Zero latency (no 250ms delay)
      - No key-sticking issues (state perfectly synced)
      - More responsive user experience
      
      To find key position: count from top-left (0-indexed), left-to-right, top-to-bottom.
      Set to -1 (default) to disable and fall back to scroll-layer mode.
  snipe-mode-key-position:
    type: int
    default: -1
    required: false
    description: |
      ⭐ RECOMMENDED MODE: Key position that activates snipe mode when pressed (zero-latency).
      When set (>= 0), this takes priority over snipe-layer.
      
      Example: snipe-mode-key-position = <36>;  // Some modifier key
      
      Advantages over snipe-layer:
      - Zero latency (no layer switching delay)
      - No key-sticking issues
      - Instant precision mode activation
      
      Set to -1 (default) to disable and fall back to snipe-layer mode.
  automouse-layer:
    type: int
    default: -1
    required: false
    description: |
      ⭐ AUTO-MOUSE LAYER: Automatically activate a layer on mouse movement (PMW3610-style).
      
      The layer index that should be automatically activated when mouse movement is
      detected, and deactivated after a timeout period of inactivity.
      
      This uses a Zephyr kernel timer for efficient, precise timing.
      
      Set to -1 (default) to disable.
      Set to a valid layer index (0-N) to enable.
      
      Example: automouse-layer = <6>;  // Auto-activate Layer 6
      
      Related properties:
      - automouse-timeout-ms: Timeout before deactivation (default 250ms)
      - automouse-threshold: Movement threshold for activation (default 5)
      
      Implementation: Uses k_timer API for efficient kernel-level timing.
  automouse-timeout-ms:
    type: int
    default: 250
    required: false
    description: |
      Auto-mouse layer timeout in milliseconds.
      
      Time after the last mouse movement before the auto-mouse layer
      is automatically deactivated.
      
      Default: 250ms
      Range: 100-5000ms recommended
      
      Example: automouse-timeout-ms = <500>;  // 500ms timeout
  automouse-threshold:
    type: int
    default: 5
    required: false
    description: |
      Movement threshold for auto-mouse layer activation.
      
      Minimum movement magnitude (abs(x) + abs(y)) required to trigger
      auto-mouse layer activation. Lower values = more sensitive.
      
      Default: 5
      Range: 1-50 recommended
      
      Example: automouse-threshold = <3>;  // More sensitive
```
